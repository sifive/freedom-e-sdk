/include/ "core.dts"
/ {
	chosen {
		metal,entry = <&spi0 1 4194304>;
		metal,boothart = <&L6>;
		stdout-path = "/soc/serial@10013000:115200";
		metal,itim = <&dtim 0 0>;
		metal,ram = <&dtim 0 0>;
	};
};
