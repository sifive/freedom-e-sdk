/include/ "core.dts"
/ {
	chosen {
		metal,entry = <&qspi0 1 4194304>;
		metal,boothart = <&cpu0>;
		stdout-path = "/soc/uart@10013000:115200";
		metal,itim = <&itim 0 0>;
		metal,ram = <&dtim 0 0>;
	};
};
